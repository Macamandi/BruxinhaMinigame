#include <Wire.h>
#include <Adafruit_GFX.h>
#include <Adafruit_SSD1306.h>
#include <avr/pgmspace.h> // Biblioteca para usar PROGMEM

// --- Configurações da Tela ---
#define SCREEN_WIDTH 128
#define SCREEN_HEIGHT 64
#define OLED_RESET    -1
Adafruit_SSD1306 display(SCREEN_WIDTH, SCREEN_HEIGHT, &Wire, OLED_RESET);
// --- Pinos de Controle ---
#define UP_BUTTON     5
#define DOWN_BUTTON   4
#define LEFT_BUTTON   3
#define RIGHT_BUTTON  2
#define BUZZER 6

//--- Definições do Atlas de Sprites ---
#define SPRITESHEET_WIDTH 240
#define WITCH_WIDTH   48
#define WITCH_HEIGHT  48
#define BAT_WIDTH     16
#define BAT_HEIGHT    48
#define ICON_WIDTH    16
#define ICON_HEIGHT   16

#define SPRITE_A_X 0    // Game Over 48x48
#define SPRITE_B_X 48   // Neutra 48x48
#define SPRITE_C_X 96   // Ataque 48x48
#define SPRITE_D_X 144  // Dano 48x48
#define SPRITE_E_X 192  // Morcego frame 1 16x48
#define SPRITE_F_X 208  // Morcego frame 2 16x48
#define ICON_STACK_X 224
#define SPRITE_G_Y 0    // Chapéu (vida)
#define SPRITE_H_Y 16   // Bombom (power-up)
#define SPRITE_I_Y 32   // Estrelinha (ataque)

// Matriz de Sprites
const unsigned char PROGMEM spritesheet[] = {
	0x00, 0x00, 0x00, 0x00, 0x00, 0x00, 0x00, 0x00, 0x3f, 0xff, 0x00, 0x00, 0x00, 0x00, 0x7f, 0xff, 
	0x80, 0x00, 0x00, 0x3f, 0xff, 0xc0, 0x00, 0x00, 0x00, 0x00, 0x00, 0x00, 0x00, 0x00, 0x00, 0x00, 
	0x00, 0x00, 0x00, 0x00, 0x00, 0x00, 0x40, 0x00, 0x80, 0x00, 0x00, 0x00, 0x80, 0x00, 0x40, 0x00, 
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	0x81, 0x40, 0xaa, 0xab, 0x06, 0xaa, 0xa8, 0x01, 0x56, 0x00, 0xd5, 0x55, 0xd5, 0x55, 0x00, 0x00
};
// --- Estruturas e Estados de Jogo ---
enum BatState { INACTIVE, ACTIVE, DEFEATED };
#define MAX_BATS 3 
struct Bat {
  int16_t x, y;
  BatState state;
  bool movingRight;
  uint8_t currentFrame;
  unsigned long defeatedEndTime;
};
struct Witch {
  int16_t x, y;
  bool isFlipped;
  int lives;
  unsigned long attackEndTime;
  unsigned long damageEndTime;
  bool attackButtonReleased;
};
struct PowerUp {
  int16_t x, y;
  bool active;
  bool movingRight;
};

// --- Variáveis Globais ---
Bat bats[MAX_BATS];
Witch player;
PowerUp bombom;
unsigned int score = 0;
unsigned int highscore = 0;
int batSpeed = 2;
unsigned long nextBatSpawnTime = 0;
unsigned long batSpawnInterval = 3000; 
unsigned long lastBatUpdateTime = 0;
unsigned long batMoveInterval = 80;
unsigned long lastBatAnimTime = 0;
#define BAT_ANIM_INTERVAL 200
#define BOMBOM_SPEED 2
unsigned long nextBombomSpawnTime = 0;
#define BOMBOM_SPAWN_INTERVAL 15000

// --- Variáveis de Jogo e Controle ---
bool needsRedraw = true;
#define ATTACK_DURATION 250
#define DAMAGE_DURATION 1000
#define GAMEOVER_DURATION 1000
#define ATTACK_RANGE 5
#define DEFEATED_DURATION 500 
int attackRangeBonus = 0;
bool isGameOver = false;
unsigned long lastButtonPressTime = 0;
#define DEBOUNCE_DELAY 200

// --- Declaração das funções ---
void spawnBat(); void updateBats(); void drawBats();
void spawnBombom();
void updateBombom(); void drawBombom();
void updateGameLogic(); void updateBatAnimation();
void clearAllBats(); void resetGame(); 
void handleInput(); 
void handleSerialInput(); // <-- DECLARAÇÃO DA NOVA FUNÇÃO
void attack(); void drawHUD(); void drawScreen();
void drawSprite(int16_t x, int16_t y, int16_t spriteX, int16_t spriteY, int16_t w, int16_t h, bool flipped);
void enviarFrameParaPC();

void setup() {
  Serial.begin(500000); 
  randomSeed(analogRead(0));
  if(!display.begin(SSD1306_SWITCHCAPVCC, 0x3C)) {
    Serial.println(F("Falha ao iniciar SSD1306"));
    for(;;);
  }
  pinMode(UP_BUTTON, INPUT_PULLUP); 
  pinMode(DOWN_BUTTON, INPUT_PULLUP);
  pinMode(LEFT_BUTTON, INPUT_PULLUP);
  pinMode(RIGHT_BUTTON, INPUT_PULLUP);
  pinMode(BUZZER, OUTPUT);
  resetGame();
  display.clearDisplay(); 
  display.display();
}

void loop() {
  if (isGameOver) {
    if (millis() - player.damageEndTime > GAMEOVER_DURATION) {
			for(int i=0;i<3;i++){
				tone(BUZZER,600);
        delay(100); 
        noTone(BUZZER); 
        delay(50);
			}
      delay(1000); 
      noTone(BUZZER); 
      resetGame();
    }
  } else {
    handleInput();        // Lida com os botões físicos
    handleSerialInput();  // <-- CHAMADA DA NOVA FUNÇÃO (Lida com o controle do PC)
    updateGameLogic();
  }
  if (player.attackEndTime != 0 && millis() > player.attackEndTime) {
      player.attackEndTime = 0;
      needsRedraw = true;
  }
  if (needsRedraw) {
    drawScreen();
    enviarFrameParaPC(); // Envia o frame para o PC
    needsRedraw = false;
  }
}

// --- FUNÇÕES DE LÓGICA DO JOGO ---
void updateGameLogic() {
  if (millis() < player.damageEndTime) return;
  if (millis() >= nextBatSpawnTime) {
    spawnBat();
    if (batSpawnInterval > 1000) batSpawnInterval -= 50;
    nextBatSpawnTime = millis() + batSpawnInterval;
  }
  if (millis() >= nextBombomSpawnTime) {
    spawnBombom();
  }
  if (millis() - lastBatUpdateTime > batMoveInterval) {
    updateBats();
    updateBombom();
    lastBatUpdateTime = millis();
  }
  if (millis() - lastBatAnimTime > BAT_ANIM_INTERVAL) {
    updateBatAnimation(); 
    lastBatAnimTime = millis();
  }
}

void handleInput() {
  if (millis() - lastButtonPressTime < DEBOUNCE_DELAY) return;
  bool buttonPressed = false;
  if (digitalRead(LEFT_BUTTON) == HIGH && digitalRead(RIGHT_BUTTON) == HIGH) {
      player.attackButtonReleased = true;
  }
  if (digitalRead(UP_BUTTON) == LOW && player.y > 0) {
    player.y = 0; 
    buttonPressed = true;
  } else if (digitalRead(DOWN_BUTTON) == LOW && player.y < 16) {
    player.y = 16; 
    buttonPressed = true;
  } else if (digitalRead(LEFT_BUTTON) == LOW && player.attackEndTime == 0 && player.attackButtonReleased) {
    player.isFlipped = true; 
    attack();
    player.attackButtonReleased = false; 
    buttonPressed = true;
  } else if (digitalRead(RIGHT_BUTTON) == LOW && player.attackEndTime == 0 && player.attackButtonReleased) {
    player.isFlipped = false;
    attack(); 
    player.attackButtonReleased = false; 
    buttonPressed = true;
  }
  if (buttonPressed) {
    lastButtonPressTime = millis();
    needsRedraw = true;
  }
}

void attack() { 
  player.attackEndTime = millis() + ATTACK_DURATION;
}

void drawHUD() {
  for (int i = 0; i < player.lives; i++) {
    drawSprite(i * (ICON_WIDTH + 2), 0, ICON_STACK_X, SPRITE_G_Y, ICON_WIDTH, ICON_HEIGHT, false);
  }
  display.setTextSize(1); 
  display.setTextColor(SSD1306_WHITE);
  int scoreCursorX = SCREEN_WIDTH - (score < 10 ? 6 : (score < 100 ? 12 : (score < 1000 ? 18 : 24)));
  display.setCursor(scoreCursorX, 0); 
  display.print(score);
  int highscoreCursorX = SCREEN_WIDTH - (highscore < 10 ? 6 : (highscore < 100 ? 12 : (highscore < 1000 ? 18 : 24)));
  display.setCursor(highscoreCursorX, 8); 
  display.print(highscore);
}

void drawScreen() {
  display.clearDisplay();
  drawHUD();
  drawBats();
  drawBombom();
  int spriteSourceX;
  if (isGameOver) spriteSourceX = SPRITE_A_X;
  else if (millis() < player.damageEndTime) spriteSourceX = SPRITE_D_X;
  else if (player.attackEndTime != 0) spriteSourceX = SPRITE_C_X;
  else spriteSourceX = SPRITE_B_X;
  drawSprite(player.x, player.y, spriteSourceX, 0, WITCH_WIDTH, WITCH_HEIGHT, player.isFlipped);
  display.display();
}

void spawnBat() {
  for (int i = 0; i < MAX_BATS; i++) {
    if (bats[i].state == INACTIVE) {
      bats[i].state = ACTIVE;
      bats[i].currentFrame = random(2);
      if (random(2) == 0) { 
        bats[i].x = -BAT_WIDTH;
        bats[i].movingRight = true;
      } else { 
        bats[i].x = SCREEN_WIDTH; 
        bats[i].movingRight = false;
      }
      bats[i].y = (random(2) == 0) ? 0 : 16;
      return;
    }
  }
}

void spawnBombom() {
  if (!bombom.active) {
    bombom.active = true;
    if (random(2) == 0) { 
      bombom.x = -ICON_WIDTH; 
      bombom.movingRight = true;
    } else { 
      bombom.x = SCREEN_WIDTH; 
      bombom.movingRight = false;
    }
    bombom.y = (random(2) == 0) ? 32 : 48;
    nextBombomSpawnTime = millis() + BOMBOM_SPAWN_INTERVAL;
  }
}

void updateBombom() {
  if (!bombom.active) return;
  if (bombom.movingRight) bombom.x += BOMBOM_SPEED; else bombom.x -= BOMBOM_SPEED;
  needsRedraw = true;
  bool yOverlap = (player.y == 0 && bombom.y == 32) || (player.y == 16 && bombom.y == 48);
  bool xOverlap = (player.x < bombom.x + ICON_WIDTH && player.x + WITCH_WIDTH > bombom.x);
  if (yOverlap && xOverlap) {
    if (player.lives < 2) {
      player.lives++;
    } else {
      batSpeed++;
      attackRangeBonus += 5;
    }
    score++;
    tone(BUZZER, 1500, 100);
    bombom.active = false;
  }
  
  if (bombom.x < -ICON_WIDTH || bombom.x > SCREEN_WIDTH) {
    bombom.active = false;
  }
}

void updateBats() {
  for (int i = 0; i < MAX_BATS; i++) {
    if (bats[i].state == INACTIVE) continue;
    if (bats[i].state == DEFEATED) {
      if (millis() > bats[i].defeatedEndTime) { 
        bats[i].state = INACTIVE;
        needsRedraw = true; 
      }
      continue;
    }

    if (bats[i].movingRight) bats[i].x += batSpeed;
    else bats[i].x -= batSpeed;
    needsRedraw = true;

    if (player.attackEndTime != 0 && bats[i].state == ACTIVE) {
        bool yOverlap = (player.y == bats[i].y);
        if (!player.isFlipped && bats[i].x > player.x) {
            int distance = bats[i].x - (player.x + WITCH_WIDTH);
            if (yOverlap && distance >= 0 && distance < (ATTACK_RANGE + attackRangeBonus)) {
                score++;
                bats[i].state = DEFEATED;
                bats[i].defeatedEndTime = millis() + DEFEATED_DURATION;
                tone(BUZZER, 1200, 50); 
                continue;
            }
        } 
        else if (player.isFlipped && bats[i].x < player.x) {
            int distance = player.x - (bats[i].x + BAT_WIDTH);
            if (yOverlap && distance >= 0 && distance < (ATTACK_RANGE + attackRangeBonus)) {
                score++;
                bats[i].state = DEFEATED;
                bats[i].defeatedEndTime = millis() + DEFEATED_DURATION;
                tone(BUZZER, 1200, 50);
                continue;
            }
        }
    }

    if (millis() > player.damageEndTime) {
        bool yOverlap = (player.y == bats[i].y);
        bool xOverlap = (player.x < bats[i].x + BAT_WIDTH && player.x + WITCH_WIDTH > bats[i].x);
        if (xOverlap && yOverlap) {
          player.lives--;
          batSpeed = 2;
          attackRangeBonus = 0;
          tone(BUZZER,330,100); 
          tone(BUZZER,660,25);
          player.damageEndTime = millis() + DAMAGE_DURATION;
          clearAllBats();
          if (player.lives < 0) {
            if (score > highscore) highscore = score;
            isGameOver = true;
          }
          return;
        }
    }

    if (bats[i].x < -BAT_WIDTH || bats[i].x > SCREEN_WIDTH) {
      bats[i].state = INACTIVE;
    }
  }
}

void updateBatAnimation() {
  bool needsRedrawCheck = false;
  for (int i = 0; i < MAX_BATS; i++) {
    if (bats[i].state == ACTIVE) {
      bats[i].currentFrame = !bats[i].currentFrame;
      needsRedrawCheck = true;
    }
  }
  if(needsRedrawCheck) needsRedraw = true;
}

void drawBats() {
  for (int i = 0; i < MAX_BATS; i++) {
    if (bats[i].state == ACTIVE) {
      int16_t spriteToDrawX = (bats[i].currentFrame == 0) ?
      SPRITE_E_X : SPRITE_F_X;
      drawSprite(bats[i].x, bats[i].y, spriteToDrawX, 0, BAT_WIDTH, BAT_HEIGHT, false);
    } else if (bats[i].state == DEFEATED) {
      drawSprite(bats[i].x, bats[i].y, ICON_STACK_X, SPRITE_I_Y, ICON_WIDTH, ICON_HEIGHT, false);
    }
  }
}

void drawBombom() {
  if (bombom.active) {
    drawSprite(bombom.x, bombom.y, ICON_STACK_X, SPRITE_H_Y, ICON_WIDTH, ICON_HEIGHT, false);
  }
}

void clearAllBats() {
  for (int i = 0; i < MAX_BATS; i++) bats[i].state = INACTIVE;
}

void resetGame() {
  player.lives = 2; 
  player.x = 40; 
  player.y = 16;
  player.isFlipped = false; 
  player.attackEndTime = 0;
  player.damageEndTime = 0; 
  player.attackButtonReleased = true;
  score = 0; 
  isGameOver = false;
  batSpawnInterval = 3000;
  nextBatSpawnTime = millis() + batSpawnInterval;
  nextBombomSpawnTime = millis() + BOMBOM_SPAWN_INTERVAL;
  batSpeed = 2; 
  attackRangeBonus = 0;
  bombom.active = false;
  clearAllBats();
  needsRedraw = true;
}

void drawSprite(int16_t x, int16_t y, int16_t spriteX, int16_t spriteY, int16_t w, int16_t h, bool flipped) {
  int16_t spritesheetByteWidth = (SPRITESHEET_WIDTH + 7) / 8;
  for (int16_t j = 0; j < h; j++) {
    for (int16_t i = 0; i < w; i++) {
      int16_t sourceX = spriteX + i;
      int16_t sourceY = spriteY + j;
      uint8_t byte = pgm_read_byte(spritesheet + (sourceY * spritesheetByteWidth) + (sourceX / 8));
      if ((byte << (sourceX % 8)) & 0x80) {
        int16_t px = flipped ?
        x + w - 1 - i : x + i;
        display.drawPixel(px, y + j, SSD1306_WHITE);
      }
    }
  }
}

void enviarFrameParaPC() {
  Serial.write('S'); // Marcador de Início de Frame
  uint8_t *buffer = display.getBuffer();
  Serial.write(buffer, SCREEN_WIDTH * SCREEN_HEIGHT / 8);
  Serial.write('E'); // Marcador de Fim de Frame
}


// --- INÍCIO DAS NOVAS MODIFICAÇÕES ---

/**
 * @brief Lida com os comandos de controle recebidos pela porta serial do PC.
 * 'U' -> Cima, 'D' -> Baixo, 'L' -> Esquerda, 'R' -> Direita
 */
void handleSerialInput() {
  // Verifica se há algum dado disponível para ser lido na porta serial
  if (Serial.available() > 0) {
    // Lê o byte (caractere) de comando
    char comando = Serial.read();

    // Usa uma estrutura switch para executar a ação correspondente
    switch (comando) {
      case 'U': // Comando para CIMA
        if (player.y > 0) {
          player.y = 0;
          needsRedraw = true; // Sinaliza que a tela precisa ser redesenhada
        }
        break;
        
      case 'D': // Comando para BAIXO
        if (player.y < 16) {
          player.y = 16;
          needsRedraw = true;
        }
        break;
        
      case 'L': // Comando para ATAQUE À ESQUERDA
        // Apenas ataca se não estiver no meio de outro ataque
        if (player.attackEndTime == 0) {
          player.isFlipped = true; // Vira a bruxa para a esquerda
          attack();
          needsRedraw = true;
        }
        break;
        
      case 'R': // Comando para ATAQUE À DIREITA
        if (player.attackEndTime == 0) {
          player.isFlipped = false; // Vira a bruxa para a direita
          attack();
          needsRedraw = true;
        }
        break;
    }
  }
}